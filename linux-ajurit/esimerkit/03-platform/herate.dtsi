// Lisätään QEMU:n virt-koneen laitepuun perään (cat virt.dts herate.dtsi).
// PL031 on AMBA-väylän PrimeCell-laite, jonka ytimen oma rtc-pl031-ajuri
// tunnistaa. Tutoriaalin ajuria varten koneen solmu poistetaan ja tilalle
// tulee platform-laite omalla compatible-merkkijonolla.
/ {
    /delete-node/ pl031@9010000;

    herateajastin@9010000 {
        compatible = "tutoriaalit,herateajastin";
        reg = <0x00 0x9010000 0x00 0x1000>;
        interrupts = <0x00 0x02 0x04>;   // SPI 2, tasoliipaisu ylös
        label = "keittion-ajastin";
        tutoriaalit,oletusviive-s = <2>;
    };
};
