# MPS2_AN385 register map
Registers are access not given, no defined reset value unless marked. A register's access mark holds for its fields unless they carry their own. Offsets are from the block's base; lines under a group give offsets from that group; [hi:lo] are bit positions; {n}, {i} and the like mark numbered series; 'fields as' and 'values as' point back to an identical list; <NAME> marks a mode.

## Memory map
0x40000000 TIMER0
0x40004000 UART0
0x40028000 FPGAIO
0xE000ED00 SCB

## TIMER0
Base 0x40000000
0x00 CTRL
0x04 VALUE

## UART0
Base 0x40004000
0x00 DATA
0x04 STATE
0x08 CTRL
0x10 BAUDDIV

## FPGAIO
Base 0x40028000
0x00 LED
0x08 BUTTON

## SCB
Base 0xE000ED00
0x00 CPUID
0x08 VTOR
0x0C AIRCR
