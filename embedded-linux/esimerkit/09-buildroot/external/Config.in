## embedded-linux/esimerkit/09-buildroot/external/package/minit/Config.in
```kconfig
config BR2_PACKAGE_MINIT
    bool "minit"
    help
      Tutoriaalin pieni init-järjestelmä palveluineen.
```

## embedded-linux/esimerkit/09-buildroot/meta-tutoriaali/conf/layer.conf
```bitbake
# Yocto-kerroksen kuvaus (Yocto 5.0 Scarthgap).
BBPATH .= ":${LAYERDIR}"
BBFILES += "${LAYERDIR}/recipes-*/*/*.bb ${LAYERDIR}/recipes-*/*/*.bbappend"
BBFILE_COLLECTIONS += "tutoriaali"
BBFILE_PATTERN_tutoriaali = "^${LAYERDIR}/"
BBFILE_PRIORITY_tutoriaali = "6"
LAYERDEPENDS_tutoriaali = "core"
LAYERSERIES_COMPAT_tutoriaali = "scarthgap"
```

## embedded-linux/esimerkit/09-buildroot/tutoriaali_defconfig
```kconfig
# Buildroot-konfiguraatio QEMU:n virt-koneelle (Buildroot 2025.02 LTS).
# Pohjana Buildrootin oma configs/qemu_aarch64_virt_defconfig.
# @alku arkkitehtuuri
BR2_aarch64=y
BR2_cortex_a53=y
BR2_TOOLCHAIN_BUILDROOT_GLIBC=y
# @loppu arkkitehtuuri
# @alku jarjestelma
BR2_TARGET_GENERIC_HOSTNAME="tutoriaali"
BR2_INIT_BUSYBOX=y
BR2_SYSTEM_DHCP="eth0"
BR2_TARGET_GENERIC_GETTY_PORT="ttyAMA0"
BR2_PACKAGE_MINIT=y
# @loppu jarjestelma
# @alku ydin
BR2_LINUX_KERNEL=y
BR2_LINUX_KERNEL_CUSTOM_VERSION=y
BR2_LINUX_KERNEL_CUSTOM_VERSION_VALUE="6.12.20"
BR2_LINUX_KERNEL_USE_ARCH_DEFAULT_CONFIG=y
BR2_LINUX_KERNEL_CONFIG_FRAGMENT_FILES="$(BR2_EXTERNAL_TUT_PATH)/ydin.config"
BR2_LINUX_KERNEL_NEEDS_HOST_OPENSSL=y
# @loppu ydin
# @alku kuvat
BR2_TARGET_ROOTFS_EXT2=y
BR2_TARGET_ROOTFS_EXT2_4=y
BR2_TARGET_ROOTFS_EXT2_SIZE="64M"
BR2_TARGET_UBOOT=y
BR2_TARGET_UBOOT_BUILD_SYSTEM_KCONFIG=y
BR2_TARGET_UBOOT_BOARD_DEFCONFIG="qemu_arm64"
BR2_PACKAGE_HOST_QEMU=y
BR2_PACKAGE_HOST_QEMU_SYSTEM_MODE=y
# @loppu kuvat
```
