// Lisäys QEMU:n virt-koneen laitepuuhun. Liitetään puretun laitepuun
// perään: dtc yhdistää saman polun solmut, ja myöhempi arvo voittaa.

/ {
    // @alku anturi
    anturi@9100000 {
        compatible = "tutoriaalit,lampoanturi";
        reg = <0x0 0x09100000 0x0 0x1000>;
        interrupts = <0x0 0x20 0x4>;    /* SPI 32, tasoliipaisu */
        tutoriaalit,raja-arvo = <45>;
        label = "kotelo";
        status = "okay";
    };
    // @loppu anturi

    // @alku chosen
    chosen {
        bootargs = "console=ttyAMA0 loglevel=1 panic=-1";
        /* Satunnaiset siemenet tekisivät laitepuusta joka kerta
         * erilaisen. QEMU ei lisää niitä annettuun laitepuuhun. */
        /delete-property/ rng-seed;
        /delete-property/ kaslr-seed;
    };
    // @loppu chosen
};
